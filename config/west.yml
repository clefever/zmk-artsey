## config/west.yml
```yaml
manifest:
  remotes:
    - name: zmkfirmware
      url-base: https://github.com/clefever
    - name: zmk-artsey
      url-base: https://github.com/clefever
  projects:
    - name: zmk
      remote: zmkfirmware
      revision: oled-ext-pwr
      import: app/west.yml
  self:
    path: config
```
